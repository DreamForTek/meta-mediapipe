## conf/layer.conf
```bitbake
# We have a conf and classes directory, add to BBPATH
BBPATH =. "${LAYERDIR}:"

# We have a packages directory, add to BBFILES
BBFILES += "${LAYERDIR}/recipes-*/*/*.bb \
            ${LAYERDIR}/recipes-*/*/*.bbappend"

BBFILE_COLLECTIONS += "meta-mediapipe"
BBFILE_PATTERN_meta-mediapipe = "^${LAYERDIR}/"
BBFILE_PRIORITY_meta-mediapipe = "10"

LAYERVERSION_meta-mediapipe = "1"

LAYERSERIES_COMPAT_meta-mediapipe = "warrior zeus"

LAYERDEPENDS_meta-mediapipe = " \
    core \
    meta-tensorflow \
    meta-python \
    openembedded-layer \
    meta-python2 \
"

LAYER_PATH_meta-mediapipe = "${LAYERDIR}"
```
